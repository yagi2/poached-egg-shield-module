## boards/shields/poached_egg/Kconfig.defconfig
```kconfig
if SHIELD_POACHED_EGG

config ZMK_KEYBOARD_NAME
    default "Poached Egg"

endif
```

## boards/shields/poached_eggs/Kconfig.shield
```kconfig
config SHIELD_POACHED_EGGS_LEFT
    def_bool $(shields_list_contains,poached_eggs_left)

config SHIELD_POACHED_EGGS_RIGHT
    def_bool $(shields_list_contains,poached_eggs_right)
```

## config/boards/shields/poached_eggs/Kconfig.defconfig
```kconfig
if SHIELD_POACHED_EGGS_LEFT

config ZMK_KEYBOARD_NAME
    default "Poached Eggs"

config ZMK_SPLIT_ROLE_CENTRAL
    default y

endif

if SHIELD_POACHED_EGGS_LEFT || SHIELD_POACHED_EGGS_RIGHT

config ZMK_SPLIT
    default y

endif
```

## config/west.yml
```yaml
manifest:
  remotes:
    - name: zmkfirmware
      url-base: https://github.com/zmkfirmware
    - name: walk-ingegg
      url-base: https://github.com/walk-ingegg
    # Additional modules containing boards/shields/custom code can be listed here as well
    # See https://docs.zephyrproject.org/3.2.0/develop/west/manifest.html#projects
  projects:
    - name: zmk
      remote: zmkfirmware
      revision: main
    - name: poached-egg-shield-module
      remote: walk-ingegg
      revision: main
  self:
    path: config
```
